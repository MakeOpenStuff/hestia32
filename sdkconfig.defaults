## src/Kconfig.projbuild
```kconfig
menu "Hestia32 Configuration"

    choice HESTIA32_BOARD_TYPE
        prompt "Board Type"
        default HESTIA32_BOARD_DEVKIT
        help
            Select the ESP32-C5 board type.

        config HESTIA32_BOARD_DEVKIT
            bool "ESP32-C5-DevKit"
            help
                Official Espressif ESP32-C5 DevKit with full GPIO access.
                Supports display, relays via direct GPIO.

        config HESTIA32_BOARD_XIAO
            bool "Seeed XIAO ESP32-C5"
            help
                Seeed Studio XIAO ESP32-C5 compact board.
                Limited GPIOs, uses TCA9555 I2C GPIO expander for relays.
    endchoice

    config BOARD_TYPE_DEVKIT
        bool
        default y if HESTIA32_BOARD_DEVKIT

    config BOARD_TYPE_XIAO
        bool
        default y if HESTIA32_BOARD_XIAO

    config RELAY_ACTIVE_LOW
        bool "Relay active-low outputs (LOW = ON, HIGH = OFF)"
        default y
        help
            Select relay output polarity.
            - Enabled: LOW turns relay ON, HIGH turns relay OFF.
            - Disabled: HIGH turns relay ON, LOW turns relay OFF.
            Set this to match your relay module input polarity.

    choice HESTIA32_PROTOCOL
        prompt "Communication Protocol"
        default HESTIA32_PROTOCOL_MQTT
        help
            Select the communication protocol for smart home integration.
            This determines which protocol stack is compiled into the firmware.

        config HESTIA32_PROTOCOL_MQTT
            bool "MQTT over WiFi"
            help
                Use MQTT protocol over WiFi for communication.
                Requires WiFi provisioning and MQTT broker configuration.
                Compatible with Home Assistant, OpenHAB, and other MQTT-based systems.

        config HESTIA32_PROTOCOL_ZIGBEE
            bool "Zigbee"
            help
                Use Zigbee protocol for communication (NOT YET IMPLEMENTED).
                Requires Zigbee coordinator and network commissioning.
                Compatible with Zigbee2MQTT, ZHA, and Zigbee hubs.
                NOTE: This option is a placeholder for future development.

        config HESTIA32_PROTOCOL_MATTER
            bool "Matter"
            help
                Use Matter protocol for communication (NOT YET IMPLEMENTED).
                Compatible with Apple HomeKit, Google Home, Amazon Alexa.
                Supports multi-fabric (multiple ecosystems simultaneously).
                NOTE: This option is a placeholder for future development.
    endchoice

    config PROTOCOL_MQTT
        bool
        default y if HESTIA32_PROTOCOL_MQTT

    config PROTOCOL_ZIGBEE
        bool
        default y if HESTIA32_PROTOCOL_ZIGBEE

    config PROTOCOL_MATTER
        bool
        default y if HESTIA32_PROTOCOL_MATTER

    choice HESTIA32_DEVICE_MODEL
        prompt "Default Device Model"
        default HESTIA32_MODEL_HVAC
        help
            Sets the compile-time default for device model on first boot.
            The user can change this later in Settings → Model.
            This value is never erased by factory reset.

        config HESTIA32_MODEL_HVAC
            bool "HVAC (North American: R + Y1/Y2/W1/W2/G)"
            help
                Default for North American HVAC systems.
                Common wire = R (24VAC), output terminals = Y1, Y2, W1, W2, G.

        config HESTIA32_MODEL_EU
            bool "EU (European mains: N + L1-L5)"
            help
                Default for European mains-wiring systems.
                Common wire = N (neutral), output terminals = L1, L2, L3, L4, L5.
    endchoice

    config DEFAULT_DEVICE_MODEL_HVAC
        bool
        default y if HESTIA32_MODEL_HVAC

    config DEFAULT_DEVICE_MODEL_EU
        bool
        default y if HESTIA32_MODEL_EU

endmenu
```

## tests/test_blink/sdkconfig.defaults
```kconfig
CONFIG_ESP_CONSOLE_UART=y
CONFIG_ESP_CONSOLE_UART_NUM=0
CONFIG_USJ_ENABLE_USB_SERIAL_JTAG=n
```
